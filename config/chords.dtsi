#define TCOMBO(NAME, BINDINGS, INNER_BINDINGS, OUTER_BINDINGS,  BOTH_BINDINGS, KEYPOS) \
combo_l_##NAME { \
	timeout-ms = <COMBO_TIMEOUT>; \
	bindings = <BINDINGS>; \
	key-positions = <KEYPOS>; \
	layers = <COMBO_LAYERS>; \
}; \
combo_li_##NAME { \
	timeout-ms = <COMBO_TIMEOUT>; \
	bindings = <INNER_BINDINGS>; \
	key-positions = <KEYPOS LIT>; \
	layers = <COMBO_LAYERS>; \
}; \
combo_lo_##NAME { \
	timeout-ms = <COMBO_TIMEOUT>; \
	bindings = <OUTER_BINDINGS>; \
	key-positions = <KEYPOS LOT>; \
	layers = <COMBO_LAYERS>; \
}; \
combo_lb_##NAME { \
	timeout-ms = <COMBO_TIMEOUT>; \
	bindings = <BOTH_BINDINGS>; \
	key-positions = <KEYPOS LIT LOT>; \
	layers = <COMBO_LAYERS>; \
}; \

combo_l_space {
	timeout-ms = <COMBO_TIMEOUT>;
	bindings = <&kp SPACE>;
	key-positions = <SIT>;
	layers = <COMBO_LAYERS>;
};

combo_l_bspc {
	timeout-ms = <COMBO_TIMEOUT>;
	bindings = <&kp BSPC>;
	key-positions = <SOT>;
	layers = <COMBO_LAYERS>;
};

//    (name,   press,       inner,         out,         both,          chord)
TCOMBO(B,      &kp B,       &kp LS(B),     &kp LEFT,    &kp LS(LEFT),  SN)
TCOMBO(F,      &kp F,       &kp LS(F),     &kp UP,      &kp LS(UP),    SA)
TCOMBO(T,      &kp T,       &kp LS(T),     &kp DOWN,    &kp LS(DOWN),  SO)
TCOMBO(J,      &kp J,       &kp LS(J),     &kp RIGHT,   &kp LS(RIGHT), SE)
TCOMBO(H,      &kp H,       &kp LS(H),     &sk LGUI,    &kp HOME,      SP)
TCOMBO(C,      &kp C,       &kp LS(C),     &sk LALT,    &kp PG_UP,     SC)
TCOMBO(N,      &kp N,       &kp LS(N),     &sk LCTRL,   &kp PG_DN,     SH)
TCOMBO(Y,      &kp Y,       &kp LS(Y),     &sk LSHIFT,  &kp END,       ST)
TCOMBO(D,      &kp D,       &kp LS(D),     &kp N1,      &kp F1,        SN SE)
TCOMBO(K,      &kp K,       &kp LS(K),     &kp N2,      &kp F2,        SP ST)
TCOMBO(R,      &kp R,       &kp LS(R),     &kp N3,      &kp F3,        SP SC)
TCOMBO(V,      &kp V,       &kp LS(V),     &kp N4,      &kp F4,        SH ST)
TCOMBO(L,      &kp L,       &kp LS(L),     &kp N5,      &kp F5,        SN SA)
TCOMBO(G,      &kp G,       &kp LS(G),     &kp N6,      &kp F6,        SO SE)
TCOMBO(E,      &kp E,       &kp LS(E),     &kp N7,      &kp F7,        SC SH)
TCOMBO(Z,      &kp Z,       &kp LS(Z),     &kp N8,      &kp F8,        SA SO)
TCOMBO(S,      &kp S,       &kp LS(S),     &kp N9,      &kp F9,        SP SH)
TCOMBO(M,      &kp M,       &kp LS(M),     &kp N0,      &kp F10,       SC ST)
TCOMBO(U,      &kp U,       &kp LS(U),     &kp EXCL,    &kp F11,       SN SO)
TCOMBO(P,      &kp P,       &kp LS(P),     &kp AT,      &kp F12,       SA SE)
TCOMBO(COMMA,  &kp COMMA,   &kp LS(COMMA), &kp HASH,    &none,         SN ST)
TCOMBO(X,      &kp X,       &kp LS(X),     &kp DLLR,    &none,         SP SE)
TCOMBO(Q,      &kp Q,       &kp LS(Q),     &kp PRCNT,   &none,         SN SH)
TCOMBO(LBKT,   &kp LBKT,    &kp LS(LBKT),  &kp CARET,   &none,         SC SE)
TCOMBO(SEMI,   &kp SEMI,    &kp LS(SEMI),  &kp AMPS,    &none,         SP SO)
TCOMBO(I,      &kp I,       &kp LS(I),     &kp STAR,    &none,         SA ST)
TCOMBO(DOT,    &kp DOT,     &kp LS(DOT),   &kp LPAR,    &none,         SN SC)
TCOMBO(W,      &kp W,       &kp LS(W),     &kp RPAR,    &none,         SE SH)
TCOMBO(O,      &kp O,       &kp LS(O),     &kp SLASH,   &none,         SA SH)
TCOMBO(SQT,    &kp SQT,     &kp LS(SQT),   &kp QMARK,   &none,         SO SC)
TCOMBO(A,      &kp A,       &kp LS(A),     &kp MINUS,   &none,         SO ST)
TCOMBO(RBKT,   &kp RBKT,    &kp LS(RBKT),  &kp UNDER,   &none,         SA SP)
TCOMBO(GRAVE,  &kp GRAVE,   &kp LS(GRAVE), &kp EQUAL,   &none,         SA SO SE)
TCOMBO(NUBS,   &kp NUBS,    &kp LS(NUBS),  &kp PLUS,    &none,         SC SH ST)
TCOMBO(DEL,    &kp DEL,     &none,         &kp LC(DEL), &none,         SA SC)
TCOMBO(ESC,    &kp ESC,     &none,         &kp N1,      &none,         SO SH)
TCOMBO(TAB,    &kp TAB,     &kp LA(TAB),   &kp LC(TAB), &none,         SN SP)
TCOMBO(ENTER,  &kp ENTER,   &kp LS(ENTER), &none,       &none,         SE ST)
TCOMBO(boot,   &none,       &none,  &ext_power EP_OFF,  &bootloader,   SN SA SO SE)
TCOMBO(BT,     &bt BT_SEL 0,&bt BT_SEL 1,  &bt BT_SEL 2,&bt BT_CLR,    SP SC SH ST)
